## arch/arm/mach-mx5/ge_imx53_modul/Kconfig
```kconfig
config MACH_GE_IMX53_MODUL_GHZ
	bool "Support 1GHZ on ge_imx53_modul (CAUTION!) (EXPERIMENTAL)"
	depends on EXPERIMENTAL && MACH_GE_IMX53_MODUL
	help
	  Support for 1GHz CPU-Clock on ge_imx53_modul. 
	  Caution: 1GHz for imx537 is out of specification.

menu "ge_imx53_modul boards"

config MACH_GE_IMX53_TESTBOARD
	bool "Support for ge_imx53_modul-Testboard"
	depends on MACH_GE_IMX53_MODUL
	help
	  Support for ge_imx53_modul-Testboard. (imx53_testboard) All module-independend Pads are declared as gpio

config MACH_GE_IMX53_DEVBOARD
	bool "Support for ge_imx53_modul-Devboard"
	depends on MACH_GE_IMX53_MODUL
	help
	  Support for ge_imx53_modul-Devboard (imx53_devboard)

config MACH_GE_IMX53_BEP2
	bool "Support for ge_imx53_modul-BEP2"
	depends on MACH_GE_IMX53_MODUL
	help
	  Support for ge_imx53_modul-BEP2

config MACH_GE_IMX53_MMI
	bool "Support for ge_imx53_modul-MMI"
	depends on MACH_GE_IMX53_MODUL
	help
	  Support for ge_imx53_modul-MMI

config MACH_GE_IMX53_BT
	bool "Support for ge_imx53_modul-BT"
	depends on MACH_GE_IMX53_MODUL
	help
	  Support for ge_imx53_modul-BT

config MACH_GE_IMX53_TERA_COM
	bool "Support for ge_imx53_modul-TERA_COM (DFU_BOX)"
	depends on MACH_GE_IMX53_MODUL
	help
	  Support for ge_imx53_modul-TERA_COM (DFU_BOX)"

config MACH_GE_IMX53_SIGMA2
	bool "Support for ge_imx53_modul-sigma2"
	depends on MACH_GE_IMX53_MODUL
	help
	  Support for ge_imx53_modul-SIGMA2

endmenu
```

## drivers/misc/switches/Kconfig
```kconfig
config GE_SWITCH_CLASS
	tristate "Ginzinger: switch device class"
	default n
	help
	  This driver implements a switch device class. It is only useful
	  together with one of the switch drivers.

config GE_SWITCH_GPIO
	tristate "Ginzinger: GPIO switch"
	depends on GENERIC_GPIO && GE_SWITCH_CLASS
	default n
	help
	  This driver provides a switch class instance based on GPIOs and
	  is used for platform switch devices such as dip switches.
```

## drivers/pnet/Kconfig
```kconfig
#
# PNET configuration
#

menu "PNET support"

config PNET
	tristate "PNET support"
	---help---
	  If you want PNET support, you should say Y here.

config PNET_NS_SPI
	tristate "Netsilicon SPI Slave Packet Driver"
	depends on (A9M9_BOARD_GEA9A7DEV || A9M9_BOARD_ETABEB || A9M9_BOARD_ETA_BEP || A9M9_BOARD_CMCX || A9M9_BOARD_BHZ_B || A9M9_BOARD_LWE_CU || A9M9_BOARD_KAP_BED) && PNET
	help
	  PNET Netsilicon SPI Slave Packet Driver

config PNET_LOOPBACK
	tristate "Loopback Packet Driver (EXPERIMENTAL)"
	depends on EXPERIMENTAL && PNET
	help
	  PNET Loopback Packet Driver

config PNET_LOCAL
	tristate "Local Packet Driver (not functional) (EXPERIMENTAL)"
	depends on EXPERIMENTAL && PNET
	help
	  PNET Local Packet Driver

config PNET_FIFO
	tristate "PNET Fifo Driver"
	depends on PNET
	help
	  PNET Fifo Driver

config PNET_SERIAL
	tristate "PNET Serial Driver"
	depends on PNET
	help
	  PNET Serial Driver

config PNET_TS
	tristate "PNET Touchscreen Driver"
	depends on PNET && INPUT
	help
	  PNET Touchscreen Driver

config PNET_RDEV
	tristate "PNET Remote-Device Driver"
#	depends on (A9M9_BOARD_GEA9A7DEV || A9M9_BOARD_CMCX || A9M9_BOARD_BHZ_B || A9M9_BOARD_LWE_CU || A9M9_BOARD_KAP_BED) && PNET
	depends on PNET
	help
	  PNET Remote-Device Driver

	  Caution: Enabling this driver is only allowed, if it is enabled on the remote side too. Else pnet will block.

config PNET_RDEV_DEBUG
	bool "PNET_RDEV debugging messages"
	depends on PNET_RDEV
	help
	  Say Y here if you want the PNET_RDEV Driver to 
	  produce a bunch of debug messages to the system log.  

config PNET_SYSTEM
	tristate "PNET System Driver"
#	depends on (A9M9_BOARD_GEA9A7DEV || A9M9_BOARD_CMCX || A9M9_BOARD_BHZ_B || A9M9_BOARD_LWE_CU || A9M9_BOARD_KAP_BED) && PNET_RDEV
	depends on PNET_RDEV
	help
	  PNET System Driver (over pnet_rdev)

config PNET_SYSTEM_DEBUG
	bool "PNET_SYSTEM debugging messages"
	depends on PNET_SYSTEM
	help
	  Say Y here if you want the PNET_SYSTEM Driver to 
	  produce a bunch of debug messages to the system log.  

config PNET_CAN
	tristate "PNET Can Driver"
#	depends on (A9M9_BOARD_GEA9A7DEV || A9M9_BOARD_CMCX || A9M9_BOARD_BHZ_B || A9M9_BOARD_LWE_CU || A9M9_BOARD_KAP_BED) && PNET_RDEV
	depends on PNET_RDEV
	help
	  PNET Can Driver (over pnet_rdev)

config PNET_CAN_DEBUG
	bool "PNET_CAN debugging messages"
	depends on PNET_CAN
	help
	  Say Y here if you want the PNET_CAN Driver to 
	  produce a bunch of debug messages to the system log.  

config PNET_GE_CAN
	tristate "PNET Ginzinger Can Layer (EXPERIMENTAL)"
	depends on EXPERIMENTAL && PNET_CAN
	help
	  GE_CAN-Driver over PNET_CAN

config PNET_GE_CAN_DEBUG
	bool "PNET_GE_CAN debugging messages"
	depends on PNET_GE_CAN
	help
	  Say Y here if you want the PNET_GE_CAN Driver to 
	  produce a bunch of debug messages to the system log.  

config PNET_DEBUG
	bool "PNET drivers debugging messages"
	depends on PNET
	help
	  Say Y here if you want the PNET Drivers to 
	  produce a bunch of debug messages to the system log.  

endmenu
```
